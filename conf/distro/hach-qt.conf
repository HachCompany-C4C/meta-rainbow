## conf/distro/hach-qt.conf
```bitbake
# Distribution definition for: hach-qt
#
# Heavily based on angstrom
#

require conf/distro/angstrom.conf
DISTRO = "hach-qt"

# add sysvinit for angstrom 
# DISTRO_FEATURES_append = " sysvinit"
# remove not used distro
DISTRO_FEATURES_remove = "x11 wayland"

#Set preferred library version
PREFERRED_VERSION_tslib = "1.16"

PREFERRED_VERSION_libmodbus = "3.1.4"

PREFERRED_PROVIDER_u-boot-fw-utils = "libubootenv"
```

## conf/distro/hach-tiny.conf
```bitbake
# Distribution definition for: hach-tiny
#
# Heavily based on poky-tiny
#

require conf/distro/angstrom.conf
DISTRO = "hach-tiny"

USE_NLS="no"

# Reconfigure eglibc for a smaller installation
# Comment out any of the lines below to disable them in the build
DISTRO_FEATURES_LIBC_TINY = "libc-libm libc-crypt libc-locales libc-posix-clang-wchar libc-locale-code"
DISTRO_FEATURES_LIBC_TINY_append_x86-64 = " libc-libm-big"

# Required for "who"
DISTRO_FEATURES_LIBC_MINIMAL = "libc-utmp libc-getlogin libc-spawn"
DISTRO_FEATURES_LIBC_REGEX = "libc-posix-regexp"
DISTRO_FEATURES_LIBC_NET = "libc-inet libc-nis"

DISTRO_FEATURES_LIBC = "${DISTRO_FEATURES_LIBC_TINY} \
                        ${DISTRO_FEATURES_LIBC_MINIMAL} \
                        ${DISTRO_FEATURES_LIBC_REGEX} \
                        ${DISTRO_FEATURES_LIBC_NET} \
                       "

# Comment out any of the lines below to disable them in the build
# DISTRO_FEATURES options:
# alsa bluetooth ext2 irda pcmcia usbgadget usbhost wifi nfs zeroconf pci
DISTRO_FEATURES_TINY = "pci"
DISTRO_FEATURES_NET = "ipv4"
DISTRO_FEATURES_USB = "usbhost"
DISTRO_FEATURES_USBGADGET = "usbgadget"
DISTRO_FEATURES_WIFI = ""

DISTRO_FEATURES = "${DISTRO_FEATURES_TINY} \
                   ${DISTRO_FEATURES_NET} \
                   ${DISTRO_FEATURES_USB} \
                   ${DISTRO_FEATURES_USBGADGET} \
                   ${DISTRO_FEATURES_WIFI} \
                   ${DISTRO_FEATURES_LIBC} \
                  "

# Enable LFS - see bug YOCTO #5865
DISTRO_FEATURES_append_libc-uclibc = " largefile"

#DISTRO_FEATURES_class-native = "${DISTRO_FEATURES_DEFAULT} ${DISTRO_FEATURES_LIBC} ${POKY_DEFAULT_DISTRO_FEATURES}"

# Use tmpdevfs and the busybox runtime services
VIRTUAL-RUNTIME_dev_manager = ""
VIRTUAL-RUNTIME_login_manager = ""
VIRTUAL-RUNTIME_init_manager = "tiny-init"
VIRTUAL-RUNTIME_keymaps = ""
VIRTUAL-RUNTIME_update-alternatives = ""
VIRTUAL_FEATURES_BACKFILL_CONSIDERED += "sysvinit"
#VIRTUAL-RUNTIME_initscripts = ""
# FIXME: Consider adding "modules" to MACHINE_FEATURES and using that in
# packagegroup-core-base to select modutils-initscripts or not.  Similar with "net" and
# netbase.

# By default we only support initramfs. We don't build live as that
# pulls in a lot of dependencies for the live image and the installer, like
# udev, grub, etc.  These pull in gettext, which fails to build with wide
# character support.
#IMAGE_FSTYPES = "cpio.gz"

# Drop v86d from qemu dependency list (we support serial)
# Drop grub from meta-intel BSPs
# FIXME: A different mechanism is needed here. We could define -tiny
#        variants of all compatible machines, but that leads to a lot
#        more machine configs to maintain long term.
#MACHINE_ESSENTIAL_EXTRA_RDEPENDS = ""

# The mtrace script included by eglibc is a perl script. This means the system
# will build perl in case this package is installed. Since we don't care about
# this script for the purposes of tiny, remove the dependency from here.

# Disable python usage in opkg-utils since it won't build with tiny config
#PACKAGECONFIG_pn-opkg-utils = ""
```

## conf/layer.conf
```bitbake
# We have a conf and classes directory, add to BBPATH
BBPATH .= ":${LAYERDIR}"

# We have recipes-* directories, add to BBFILES
BBFILES += "${LAYERDIR}/recipes-*/*/*.bb ${LAYERDIR}/recipes-*/*/*.bbappend"

BBFILE_COLLECTIONS += "rainbow-layer"
BBFILE_PATTERN_rainbow-layer = "^${LAYERDIR}/"
BBFILE_PRIORITY_rainbow-layer = "98"

# Let us add layer-specific bbappends which are only applied when that
# layer is included in our configuration
BBFILES += "${@' '.join('${LAYERDIR}/%s/recipes*/*/*.bbappend' % layer \
               for layer in BBFILE_COLLECTIONS.split())}"
# Add layer-specific bb files too
BBFILES += "${@' '.join('${LAYERDIR}/%s/recipes*/*/*.bb' % layer \
for layer in BBFILE_COLLECTIONS.split())}"

# This should only be incremented on significant changes that will
# cause compatibility issues with other layers
LAYERVERSION_rainbow-layer = "1"

LAYERDEPENDS_rainbow-layer = " \
    core \
    freescale-layer \
    fsl-arm-extra \
    toradex-bsp-common-layer \
    toradex-nxp-layer \
"
```

## conf/machine/colibri-imx6-rainbow.conf
```bitbake
#@TYPE: Machine
#@NAME: Hach Colibri iMX6 Dual 1GB (eMMC)
#@SOC: i.MX 6Dual
#@DESCRIPTION: Machine configuration for Hach Colibri iMX6 SOM
#@MAINTAINER: Tim Huang <xhuang@hach.com>

MACHINEOVERRIDES =. "mx6:mx6dl:colibri-imx6-rainbow:"

include conf/machine/include/imx-base.inc
include conf/machine/include/tune-cortexa9.inc

PREFERRED_PROVIDER_virtual/kernel ??= "linux-toradex"
PREFERRED_PROVIDER_virtual/kernel_use-mainline-bsp ??= "linux-fslc"
KERNEL_DEVICETREE += "imx6dl-colibri-eval-v3.dtb imx6dl-colibri-rainbow.dtb "
KERNEL_DEVICETREE_use-mainline-bsp += "imx6dl-colibri-eval-v3.dtb"
KERNEL_IMAGETYPE = "zImage"
# The kernel lives in a seperate FAT partition, don't deploy it in /boot/
RDEPENDS_kernel-base = ""

PREFERRED_PROVIDER_u-boot ?= "u-boot-toradex"
PREFERRED_PROVIDER_virtual/bootloader ?= "u-boot-toradex"
SPL_BINARY = "SPL"
UBOOT_SUFFIX = "img"
UBOOT_CONFIG ??= "spl"
UBOOT_CONFIG[spl] = "colibri_imx6_defconfig,,u-boot.img"
UBOOT_MAKE_TARGET = ""
UBOOT_ENTRYPOINT_use-mainline-bsp = "0x10008000"

IMAGE_FSTYPES = "wic.gz tar.xz"
# wic support
WKS_FILE = "sdimage-bootpart.wks"
WIC_CREATE_EXTRA_ARGS_append = " --no-fstab-update"

SERIAL_CONSOLE ?= "115200 ttymxc0"

MACHINE_FEATURES += "screen usbgadget usbhost vfat ext2 alsa touchscreen wifi bluetooth 3g"
```

## conf/machine/colibri-imx7-rainbow.conf
```bitbake
#@TYPE: Machine
#@NAME: Hach Colibri iMX7 Dual 1GB (eMMC)
#@SOC: i.MX 7Dual
#@DESCRIPTION: Machine configuration for Hach Colibri iMX7 SOM
#@MAINTAINER: Tim Huang <xhuang@hach.com>

MACHINEOVERRIDES =. "mx7:mx7d:colibri-imx7-rainbow:"

include conf/machine/include/imx-base.inc
include conf/machine/include/tune-cortexa7.inc

PREFERRED_PROVIDER_virtual/kernel ?= "linux-toradex"
KERNEL_IMAGETYPE = "zImage"
KERNEL_DEVICETREE += "imx7d-colibri-emmc-eval-v3.dtb imx7d-colibri-emmc-rainbow.dtb"

# The kernel lives in a seperate FAT partition, don't deploy it in /boot/
RDEPENDS_kernel-base = ""

PREFERRED_PROVIDER_u-boot ?= "u-boot-toradex"
PREFERRED_PROVIDER_virtual/bootloader ?= "u-boot-toradex"
UBOOT_MACHINE ?= "colibri_imx7_emmc_defconfig"

IMAGE_FSTYPES = "ext4.xz wic.gz tar.xz"
# wic support
WKS_FILE = "sdimage-bootpart.wks"
WIC_CREATE_EXTRA_ARGS_append = " --no-fstab-update"

SERIAL_CONSOLE = "115200 ttymxc2"

MACHINE_FEATURES += "screen usbgadget usbhost vfat ext2 alsa touchscreen wifi"
```
